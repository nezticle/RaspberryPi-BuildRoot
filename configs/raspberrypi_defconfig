## configs/raspberrypi_defconfig
```kconfig
BR2_arm=y
BR2_arm1176jzf_s=y
BR2_JLEVEL=0
BR2_CCACHE=y
BR2_OPTIMIZE_2=y
BR2_TOOLCHAIN_EXTERNAL=y
BR2_TOOLCHAIN_EXTERNAL_RASPBERRYPI_ARM=y
BR2_TOOLCHAIN_EXTERNAL_DOWNLOAD=y
BR2_TOOLCHAIN_EXTERNAL_PREFIX="arm-raspberrypi-linux-gnueabi"
BR2_TOOLCHAIN_EXTERNAL_GLIBC=y
BR2_PACKAGE_GDB=y
BR2_TOOLCHAIN_EXTERNAL_GDB_SERVER_COPY=y
BR2_ENABLE_LOCALE_PURGE=y
BR2_ENABLE_LOCALE_WHITELIST="C en_US"
# BR2_SOFT_FLOAT is not set
BR2_TARGET_OPTIMIZATION="-pipe -mfloat-abi=hard -mfpu=vfp -mtune=arm1176jzf-s -march=armv6zk"
BR2_TARGET_GENERIC_HOSTNAME="raspberrypi"
BR2_TARGET_GENERIC_ISSUE="Welcome to Bsquask SDK"
BR2_ROOTFS_DEVICE_CREATION_DYNAMIC_UDEV=y
BR2_ROOTFS_SKELETON_CUSTOM=y
BR2_ROOTFS_SKELETON_CUSTOM_PATH="board/raspberrypi/skeleton"
BR2_TARGET_GENERIC_GETTY_PORT="tty3"
BR2_ROOTFS_POST_BUILD_SCRIPT="board/raspberrypi/post-build.sh"
BR2_PACKAGE_BUSYBOX_SHOW_OTHERS=y
BR2_PACKAGE_GZIP=y
BR2_PACKAGE_OPROFILE=y
BR2_PACKAGE_STRACE=y
BR2_PACKAGE_COREUTILS=y
BR2_PACKAGE_FINDUTILS=y
BR2_PACKAGE_GAWK=y
BR2_PACKAGE_GREP=y
BR2_PACKAGE_TAR=y
BR2_PACKAGE_FBSET=y
BR2_PACKAGE_LIBERATION=y
BR2_PACKAGE_DBUS_GLIB=y
BR2_PACKAGE_UDEV_RULES_GEN=y
BR2_PACKAGE_UDEV_ALL_EXTRAS=y
BR2_PACKAGE_USBMOUNT=y
BR2_PACKAGE_USBUTILS=y
BR2_PACKAGE_PYTHON=y
BR2_PACKAGE_PYTHON_BZIP2=y
BR2_PACKAGE_LIBVORBIS=y
BR2_PACKAGE_BEECRYPT=y
BR2_PACKAGE_SQLITE=y
BR2_PACKAGE_FONTCONFIG=y
BR2_PACKAGE_JPEG=y
BR2_PACKAGE_LIBPNG=y
BR2_PACKAGE_NEON=y
BR2_PACKAGE_NEON_ZLIB=y
BR2_PACKAGE_NEON_SSL=y
BR2_PACKAGE_NEON_LIBXML2=y
BR2_PACKAGE_BOOST=y
BR2_PACKAGE_LIBCAP=y
BR2_PACKAGE_PCRE=y
BR2_PACKAGE_LIBXSLT=y
BR2_PACKAGE_BLUEZ_UTILS=y
BR2_PACKAGE_BLUEZ_UTILS_COMPAT=y
BR2_PACKAGE_BLUEZ_UTILS_AUDIO=y
BR2_PACKAGE_BLUEZ_UTILS_USB=y
BR2_PACKAGE_BLUEZ_UTILS_WIIMOTE=y
BR2_PACKAGE_DHCP=y
BR2_PACKAGE_DHCP_CLIENT=y
BR2_PACKAGE_NTP=y
# BR2_PACKAGE_NTP_NTPD is not set
BR2_PACKAGE_NTP_NTPDATE=y
BR2_PACKAGE_OPENSSH=y
BR2_PACKAGE_WGET=y
BR2_PACKAGE_BASH=y
BR2_PACKAGE_FILE=y
BR2_PACKAGE_SCREEN=y
BR2_PACKAGE_SUDO=y
BR2_PACKAGE_HTOP=y
BR2_PACKAGE_KMOD_TOOLS=y
BR2_PACKAGE_PROCPS=y
BR2_PACKAGE_PSMISC=y
BR2_PACKAGE_RSYSLOG=y
BR2_PACKAGE_LESS=y
BR2_PACKAGE_NANO=y
# BR2_PACKAGE_NANO_TINY is not set
BR2_PACKAGE_VIM=y
BR2_PACKAGE_VIDEOCORE=y
BR2_PACKAGE_BOOTLOADER=y
BR2_PACKAGE_QTBASE=y
BR2_PACKAGE_QTXMLPATTERNS=y
BR2_PACKAGE_QTJSBACKEND=y
BR2_PACKAGE_QTDECLARATIVE=y
BR2_PACKAGE_QTMULTIMEDIA=y
BR2_PACKAGE_WAYLAND=y
BR2_PACKAGE_QTWAYLAND=y
BR2_PACKAGE_QTGAMEPAD=y
BR2_TARGET_ROOTFS_TAR_GZIP=y
BR2_LINUX_KERNEL=y
BR2_LINUX_KERNEL_CUSTOM_TARBALL=y
BR2_LINUX_KERNEL_CUSTOM_TARBALL_LOCATION="https://github.com/raspberrypi/linux/tarball/rpi-3.6.y/7849605f5a86c200aef88624c0c2442e35e39954.tar.gz"
BR2_LINUX_KERNEL_USE_CUSTOM_CONFIG=y
BR2_LINUX_KERNEL_CUSTOM_CONFIG_FILE="board/raspberrypi/linux-3.6-raspberrypi.config"
BR2_LINUX_KERNEL_UNCOMPRESSED=y
BR2_LINUX_KERNEL_INSTALL_TARGET=y
BR2_PACKAGE_PORTMAP=y
BR2_PACKAGE_FFMPEG_NONFREE=y
# BR2_PACKAGE_FFMPEG_FFMPEG is not set
BR2_PACKAGE_FFMPEG_AVFILTER=y
BR2_PACKAGE_FFMPEG_ENCODERS="ac3,aac"
BR2_PACKAGE_FFMPEG_MUXERS="spdif,adts"
BR2_PACKAGE_FFMPEG_PROTOCOLS="http"
# BR2_PACKAGE_FFMPEG_INDEVS is not set
# BR2_PACKAGE_FFMPEG_OUTDEVS is not set
BR2_PACKAGE_BUSYBOX_CONFIG="board/raspberrypi/busybox-1.20.2.config"
BR2_PACKAGE_OMXPLAYER=y
BR2_PACKAGE_XWIIMOTE=y
BR2_INIT_UPSTART=y
BR2_ROOTFS_DEVICE_TABLE="board/raspberrypi/device_table.txt"
BR2_PACKAGE_KBD=y
```

## package/fluidsynth/Config.in
```kconfig
config BR2_PACKAGE_FLUIDSYNTH
	bool "fluidsynth"
	select BR2_PACKAGE_ALSA_LIB_RAWMINI
	select BR2_PACKAGE_ALSA_LIB_SEQ
	select BR2_PACKAGE_ALSA_LIB_HWDEP
	depends on BR2_PACKAGE_ALSA_LIB
	help
	  Fluidsynth is a real-time soundfont software synthesizer
```

## package/libnih/Config.in
```kconfig
config BR2_PACKAGE_LIBNIH
	bool "libnih"
	select BR2_PACKAGE_DBUS
	select BR2_PACKAGE_EXPAT
	select BR2_PACKAGE_PKGCONF
	help
		libnih is a small library for C application development
		containing functions that, despite its name, are not 
		implemented elsewhere in the standard library set.
```

## package/qt5/qt3d/Config.in
```kconfig
config BR2_PACKAGE_QT3D
	bool "qt3d"
	select BR2_PACKAGE_QTBASE
	select BR2_PACKAGE_QTXMLPATTERNS
	select BR2_PACKAGE_QTJSBACKEND
	select BR2_PACKAGE_QTDECLARATIVE
	help
		Qt 5 3d module
```

## package/qt5/qtbase/Config.in
```kconfig
config BR2_PACKAGE_QTBASE
	bool "qtbase"
	select BR2_PACKAGE_PKG_CONFIG
	select BR2_PACKAGE_LIBGLIB2
	select BR2_PACKAGE_ZLIB
	select BR2_PACKAGE_JPEG
	select BR2_PACKAGE_LIBPNG
	select BR2_PACKAGE_TIFF
	select BR2_PACKAGE_FREETYPE
	select BR2_PACKAGE_DBUS
	select BR2_PACKAGE_OPENSSL
	select BR2_PACKAGE_SQLITE
	select BR2_PACKAGE_ALSA_LIB
	select BR2_PACKAGE_VIDEOCORE
	help
		Qt 5 qtbase module
```

## package/qt5/qtdeclarative/Config.in
```kconfig
config BR2_PACKAGE_QTDECLARATIVE
	bool "qtdeclarative"
	select BR2_PACKAGE_QTBASE
	select BR2_PACKAGE_QTXMLPATTERNS
	select BR2_PACKAGE_QTJSBACKEND
	help
		Qt 5 declarative module
```

## package/qt5/qtftp/Config.in
```kconfig
config BR2_PACKAGE_QTFTP
	bool "qtftp"
	select BR2_PACKAGE_QTBASE
	help
		A Qt5 module that adds support for ftp but which is deprecated.
```

## package/qt5/qtgamepad/Config.in
```kconfig
config BR2_PACKAGE_QTGAMEPAD
	bool "qtgamepad"
	select BR2_PACKAGE_QTBASE
	help
		A Qt5 module that adds support for reading
		from Gamepad devices on Linux
```

## package/qt5/qtgraphicaleffects/Config.in
```kconfig
config BR2_PACKAGE_QTGRAPHICALEFFECTS
	bool "qtgraphicaleffects"
	select BR2_PACKAGE_QTBASE
	select BR2_PACKAGE_QTDECLARATIVE
	help
		Qt 5 Graphical Effects module
```

## package/qt5/qtimageformats/Config.in
```kconfig
config BR2_PACKAGE_QTIMAGEFORMATS
	bool "qtimageformats"
	select BR2_PACKAGE_QTBASE
	help
		Qt 5 image formats module
```

## package/qt5/qtjsbackend/Config.in
```kconfig
config BR2_PACKAGE_QTJSBACKEND
	bool "qtjsbackend"
	select BR2_PACKAGE_QTBASE
	help
		Qt 5 jsbackend module
```

## package/qt5/qtmultimedia/Config.in
```kconfig
config BR2_PACKAGE_QTMULTIMEDIA
	bool "qtmultimedia"
	select BR2_PACKAGE_QTBASE
	select BR2_PACKAGE_QTDECLARATIVE
	help
		Qt 5 multimedia module
```

## package/qt5/qtquick1/Config.in
```kconfig
config BR2_PACKAGE_QTQUICK1
	bool "qtquick1"
	select BR2_PACKAGE_QTBASE
	select BR2_PACKAGE_QTSCRIPT
	select BR2_PACKAGE_QTXMLPATTERNS
	select BR2_PACKAGE_QTDECLARATIVE
	select BR2_PACKAGE_QTJSBACKEND
	select BR2_PACKAGE_QTWEBKIT
	help
		Qt 5 qtquick1 module
```

## package/qt5/qtquickcontrols/Config.in
```kconfig
config BR2_PACKAGE_QTQUICKCONTROLS
	bool "qtquickcontrols"
	select BR2_PACKAGE_QTBASE
	select BR2_PACKAGE_QTDECLARATIVE
	help
		Qt 5 QtQuick Controls module
```

## package/qt5/qtscript/Config.in
```kconfig
config BR2_PACKAGE_QTSCRIPT
	bool "qtxmlscript"
	select BR2_PACKAGE_QTBASE
	help
		Qt 5 script module
```

## package/qt5/qtsensors/Config.in
```kconfig
config BR2_PACKAGE_QTSENSORS
	bool "qtsensors"
	select BR2_PACKAGE_QTBASE
	help
		Qt 5 sensors module
```

## package/qt5/qtserialport/Config.in
```kconfig
config BR2_PACKAGE_QTSERIALPORT
	bool "qtserialport"
	select BR2_PACKAGE_QTBASE
	help
		Qt 5 serial port module
```

## package/qt5/qtsvg/Config.in
```kconfig
config BR2_PACKAGE_QTSVG
	bool "qtsvg"
	select BR2_PACKAGE_QTBASE
	help
		Qt 5 svg module
```

## package/qt5/qtwayland/Config.in
```kconfig
config BR2_PACKAGE_QTWAYLAND
	bool "qtwayland"
	select BR2_PACKAGE_QTDECLARATIVE
	select BR2_PACKAGE_WAYLAND
	select BR2_PACKAGE_XKBCOMMON
	help
		Qt 5 Wayland module
```

## package/qt5/qtwebkit/Config.in
```kconfig
config BR2_PACKAGE_QTWEBKIT
	bool "qtwebkit"
	select BR2_PACKAGE_QTBASE
	select BR2_PACKAGE_QTXMLPATTERNS
	select BR2_PACKAGE_QTJSBACKEND
	select BR2_PACKAGE_QTDECLARATIVE
	select BR2_PACKAGE_QTMULTIMEDIA
	help
		Qt 5 webkit module
```

## package/qt5/qtxmlpatterns/Config.in
```kconfig
config BR2_PACKAGE_QTXMLPATTERNS
	bool "qtxmlpatterns"
	select BR2_PACKAGE_QTBASE
	help
		Qt 5 xmlpatterns module
```

## package/raspberrypi/VideoCore/Config.in
```kconfig
config BR2_PACKAGE_VIDEOCORE
	bool "Raspberry Pi VideoCore drivers"
	help
	  These are the binary VideoCore drivers from Broadcom.
	  https://github.com/raspberrypi/userland

if BR2_PACKAGE_VIDEOCORE
config BR2_PACKAGE_VIDEOCORE_VERSION
	string "Github revision of VideoCore tar ball"
	default b58a0498f1630008dd46c80686bd8fcff79e70ca
	help
	  Enter the SHA of your preferred revision of the RPI userland files (https://github.com/raspberrypi/userland)
endif
```

## package/raspberrypi/bootloader/Config.in
```kconfig
comment "-- RaspberryPi bootloader --"
config BR2_PACKAGE_BOOTLOADER
	bool "Install Raspberry Pi bootloader files"
	help
	  These are the binary bootloader files from Broadcom.
	  https://github.com/raspberrypi/firmware

if BR2_PACKAGE_BOOTLOADER

config BR2_BOOTLOADER_VERSION
	string "Github revision of bootloader tar ball"
	default "c9c9465093f7dada45566bae65fef7fe26ce9361"
	help 
	  Enter the SHA of your preferred revision of the RPI Firmware (https://github.com/raspberrypi/firmware/)

# http://elinux.org/RPiconfig#Memory
config BR2_RASPBERRYPI_GPU_RAM_SIZE
    int "Amount of RAM dedicated to the GPU"
    default "128"
    help
      Remaining RAM will be used as system RAM.

# http://elinux.org/RPiconfig#Licensed_Codecs
config BR2_RASPBERRYPI_CONFIG_LICENSE
  bool "Configure codec licenses"
  help 
  See http://elinux.org/RPiconfig#Licensed_Codecs

if BR2_RASPBERRYPI_CONFIG_LICENSE
comment "Additional license keys for codecs"

config BR2_RASPBERRYPI_LICENSE_MPG2
  string "MPG2 license key"
  default "0xdeadbeef"
  help
    See http://www.raspberrypi.com/ for purchasing keys

config BR2_RASPBERRYPI_LICENSE_VC1
  string "VC1 license key"
  default "0xbeefdead"
  help
    See http://www.raspberrypi.com/ for purchasing keys

endif

# http://elinux.org/RPiconfig#Boot
comment "-- advanced config.txt options --"
config BR2_RASPBERRYPI_DISABLE_L2CACHE
  bool "disable L2 cache"
  default n
  help
    Disable ARM access to GPU's L2 cache. Needs corresponding L2 disabled kernel.
    CPU speed should increase at cost of GPU speed
    See http://elinux.org/RPiconfig#Memory

config BR2_RASPBERRYPI_DISABLE_SAFEMODE
  bool "disable safe mode"
  default y
  help 
    This is the config.txt option avoid_safe_mode. Useful when hardware is connected to PIN 5 & 6
    See http://elinux.org/RPI_safe_mode

config BR2_RASPBERRYPI__UART_SPEED
  int "Initial UART baudrate"
  default 115200
  help
    This sets the value for init_uart_baud.
    See http://elinux.org/RPiconfig#Boot

config BR2_RASPBERRYPI_CPU_SPEED
  int "ARM CPU Frequency (MHz)"
  default 700
  help
    Set the frequency of the ARM frequency
    See http://elinux.org/RPiconfig#Overclocking

config BR2_RASPBERRYPI_GPU_SPEED
  int "GPU frequency (Mhz)"
  default 250
  help 
    Sets core_freq, h264_freq, isp_freq, v3d_freq together
    See http://elinux.org/RPiconfig#Overclocking

config BR2_RASPBERRYPI_DISABLE_OVERSCAN
  bool "disable overscan"
  default y
  help
    Disable overscan
    See http://elinux.org/RPiconfig#Video_mode_options

comment "Kernel command line options"
config BR2_RASPBERRYPI_CMDLINE
  string "Linux kernel command line"
  default "smsc95xx.turbo_mode=N dwc_otg.lpm_enable=0 console=tty0 console=ttyAMA0,115200 kgdboc=ttyAMA0,115200 root=/dev/mmcblk0p2 rootfstype=ext4 coherent_pool=6M rootwait quiet"
  help
    Kernel parameters for properly booting the kernel. 
    Add 'smsc95xx.turbo_mode=N' to disable multiple frames per Rx transaction.
    Add 'dwc_otg.lpm-enable=0' to disable link power management on usb.

endif
```

## package/raspberrypi/mkimage/Config.in
```kconfig
config BR2_PACKAGE_MKIMAGE
	bool "Raspberry Pi mkImage tool"
	help
	  A python script make uncompressed Image bootable by Raspberry Pi.
	  https://github.com/raspberrypi/tools
```

## package/raspberrypi/omxplayer/Config.in
```kconfig
config BR2_PACKAGE_OMXPLAYER
	bool "omxplayer"
	select BR2_PACKAGE_FFMPEG
	select BR2_PACKAGE_BOOST
	select BR2_PACKAGE_PCRE
	select BR2_PACKAGE_LIBERATION
	select BR2_PACKAGE_FFMPEG_GPL
	select BR2_PACKAGE_FFMPEG_AVFILTER
	select BR2_PACKAGE_FFMPEG_SWSCALE
	select BR2_PACKAGE_FFMPEG_POSTPROC
	help
		Enables omxplayer (Media player backend
		for xbmc on Raspberry Pi)
```
