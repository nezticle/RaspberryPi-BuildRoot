## package/upstart/Config.in
```kconfig
config BR2_PACKAGE_UPSTART
	bool "upstart"
	depends on BR2_ROOTFS_DEVICE_CREATION_DYNAMIC_UDEV
	depends on BR2_INET_IPV6
	depends on BR2_TOOLCHAIN_HAS_THREADS # dbus
	select BR2_PACKAGE_DBUS
	select BR2_PACKAGE_LIBNIH
	select BR2_PACKAGE_JSON_C
	help
		Upstart is an event-based replacement for the /sbin/init
		daemon which handles starting of tasks and services
		during boot, stopping them during shutdown and supervising 
		them while the system is running.
```

## package/wayland/Config.in
```kconfig
config BR2_PACKAGE_WAYLAND
	bool "wayland"
	select BR2_PACKAGE_PKGCONF
	select BR2_PACKAGE_UDEV
	select BR2_PACKAGE_VIDEOCORE
	select BR2_PACKAGE_LIBFFI
	help
		Provides libwayland needed for wayland compositors
```

## package/wiringpi/Config.in
```kconfig
config BR2_PACKAGE_WIRINGPI
	bool "wiringPi"
	help
	  WiringPi is a GPIO access library written in C for the BCM2835 used in the Raspberry Pi.

          http://wiringpi.com/
```

## package/wpa_supplicant/Config.in
```kconfig
config BR2_PACKAGE_WPA_SUPPLICANT
	bool "wpa_supplicant"
	help
	  WPA supplicant for secure wireless networks

	  http://hostap.epitest.fi/wpa_supplicant/

if BR2_PACKAGE_WPA_SUPPLICANT

config BR2_PACKAGE_WPA_SUPPLICANT_EAP
	bool "Enable EAP"
	help
	  Enable support for EAP.

config BR2_PACKAGE_WPA_SUPPLICANT_CLI
	bool "Install wpa_cli binary"
	help
	  Install wpa_cli command line utility

config BR2_PACKAGE_WPA_SUPPLICANT_PASSPHRASE
	bool "Install wpa_passphrase binary"
	help
	  Install wpa_passphrase command line utility

config BR2_PACKAGE_WPA_SUPPLICANT_AP_SUPPORT
	bool "Enable support for soft AP"
	help
	  With this option enabled, wpa_supplicant can act as
	  access point. This can be used for open and WPA2-Personal networks
	  (optionally, with WPS); this links in parts of hostapd functionality
	  into wpa_supplicant.

config BR2_PACKAGE_WPA_SUPPLICANT_DBUS_OLD
	bool "Enable support for old DBus control interface"
	depends on BR2_PACKAGE_DBUS
	help
	  Enable support for old DBus control interface
	  (fi.epitest.hostap.WPASupplicant).

config BR2_PACKAGE_WPA_SUPPLICANT_DBUS_NEW
	bool "Enable support for new DBus control interface"
	depends on BR2_PACKAGE_DBUS
	help
	  Enable support for new DBus control interface (fi.w1.wpa_supplicant1).

config BR2_PACKAGE_WPA_SUPPLICANT_DBUS_INTROSPECTION
	bool "Introspection support"
	depends on BR2_PACKAGE_WPA_SUPPLICANT_DBUS_NEW
	help
	  Add introspection support for new DBus control interface.

config BR2_PACKAGE_WPA_SUPPLICANT_WPS
	bool "Enable support for WPS"
	help
	  Enable support for Wi-Fi Protected Setup (WPS)

comment "/etc/wpa_supplicant.conf file"

config BR2_PACKAGE_WPA_SUPPLICANT_SSID
  string "Network SSID"
  default "home"
  help
    This is the SSID name of your network.
    Check http://linux.die.net/man/5/wpa_supplicant.conf if your need more parameters.

config BR2_PACKAGE_WPA_SUPPLICANT_KEY
  string "Password"
  default "my SSID WPA key"
  help
    This is the key. Must be between quotes if litteral or without quotes if entered as hexadecimal.
    Check http://linux.die.net/man/5/wpa_supplicant.conf if your need more parameters.
endif
```

## package/xkbcommon/Config.in
```kconfig
config BR2_PACKAGE_XKBCOMMON
	bool "xkbcommon"
	help
		A library to handle keyboard descriptions.
```

## package/xproto/Config.in
```kconfig
config BR2_PACKAGE_XPROTO
	bool "xproto"
	help
		Development files for X11 protocol
```

## package/xwiimote/Config.in
```kconfig
config BR2_PACKAGE_XWIIMOTE
	bool "xwiimote"
	select BR2_PACKAGE_NCURSES
	select BR2_PACKAGE_UDEV
	help
		Provides userspace library for kernel wiimote driver
```
